## arch/x86/Kconfig.cpu.rej
```kconfig
--- arch/x86/Kconfig.cpu
+++ arch/x86/Kconfig.cpu
@@ -735,13 +1163,13 @@ config X86_CX8
 # generates cmov.
 config X86_CMOV
 	def_bool y
-	depends on (MK7 || MPENTIUM4 || MPENTIUMM || MPENTIUMIII || MPENTIUMII || M686 || MVIAC3_2 || MVIAC7 || MCRUSOE || MEFFICEON || MATOM || MGEODE_LX || X86_64)
+	depends on (MK8 || MK7 || MCORE2 || MPENTIUM4 || MPENTIUMM || MPENTIUMIII || MPENTIUMII || M686 || MVIAC3_2 || MVIAC7 || MCRUSOE || MEFFICEON || X86_64 || MATOM || MGEODE_LX)
 
 config X86_MINIMUM_CPU_FAMILY
 	int
 	default "64" if X86_64
-	default "6" if X86_32 && (MPENTIUM4 || MPENTIUMM || MPENTIUMIII || MPENTIUMII || M686 || MVIAC3_2 || MVIAC7 || MEFFICEON || MATOM || MK7)
-	default "5" if X86_32 && X86_CX8
+	default "6" if X86_32 && (MPENTIUM4 || MPENTIUMM || MPENTIUMIII || MPENTIUMII || M686 || MVIAC3_2 || MVIAC7 || MEFFICEON || MATOM || MCORE2 || MK7 || MK8)
+	default "5" if X86_32 && X86_CMPXCHG64
 	default "4"
 
 config X86_DEBUGCTLMSR
```

## mm/Kconfig.rej
```kconfig
--- mm/Kconfig
+++ mm/Kconfig
@@ -152,18 +152,6 @@ config ZSWAP_ZPOOL_DEFAULT
        default "zsmalloc" if ZSWAP_ZPOOL_DEFAULT_ZSMALLOC
        default ""
 
-config ZBLOCK
-	tristate "Fast compression allocator with high density"
-	depends on ZPOOL
-	help
-	  A special purpose allocator for storing compressed pages.
-	  It stores integer number of same size compressed objects per
-	  its block. These blocks consist of several physical pages
-	  (2**n, i. e. 1/2/4/8).
-
-	  With zblock, it is possible to densely arrange objects of
-	  various sizes resulting in low internal fragmentation.
-
 config ZSMALLOC
 	tristate
 	prompt "N:1 compression allocator (zsmalloc)" if (ZSWAP || ZRAM)
```
